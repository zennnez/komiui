/* Copyright (c) 2018-2019, The Linux Foundation. All rights reserved.
 *
 * This program is free software; you can redistribute it and/or modify
 * it under the terms of the GNU General Public License version 2 and
 * only version 2 as published by the Free Software Foundation.
 *
 * This program is distributed in the hope that it will be useful,
 * but WITHOUT ANY WARRANTY; without even the implied warranty of
 * MERCHANTABILITY or FITNESS FOR A PARTICULAR PURPOSE.  See the
 * GNU General Public License for more details.
 */

&mdss_mdp {
	dsi_nt36672a_shenchao_video: qcom,mdss_dsi_nt36672a_shenchao_video {
		qcom,mdss-dsi-panel-name =
			"nt36672a video mode dsi shenchao panel";
		qcom,mdss-dsi-panel-type = "dsi_video_mode";
		qcom,mdss-dsi-virtual-channel-id = <0>;
		qcom,mdss-pan-physical-width-dimension = <67>;
		qcom,mdss-pan-physical-height-dimension = <145>;
		qcom,mdss-dsi-bpp = <24>;
		qcom,mdss-dsi-color-order = "rgb_swap_rgb";
		qcom,mdss-dsi-traffic-mode = "non_burst_sync_event";
		qcom,mdss-dsi-lane-map = "lane_map_0123";
		qcom,mdss-dsi-bllp-eof-power-mode;
		qcom,mdss-dsi-bllp-power-mode;
		qcom,mdss-dsi-tx-eot-append;
		qcom,mdss-dsi-lane-0-state;
		qcom,mdss-dsi-lane-1-state;
		qcom,mdss-dsi-lane-2-state;
		qcom,mdss-dsi-lane-3-state;
		qcom,mdss-dsi-dma-trigger = "trigger_sw";
		qcom,mdss-dsi-mdp-trigger = "none";
		qcom,mdss-dsi-lp11-init;
		qcom,mdss-dsi-bl-pmic-control-type = "bl_ctrl_wled";
		qcom,mdss-dsi-bl-min-level = <1>;
		qcom,mdss-dsi-bl-max-level = <4095>;
		qcom,mdss-dsi-reset-sequence = <1 5>, <0 1>, <1 10>;

		qcom,mdss-dsi-display-timings {
			timing@0 {
				qcom,mdss-dsi-panel-width = <1080>;
				qcom,mdss-dsi-panel-height = <2340>;
				qcom,mdss-dsi-h-front-porch = <90>;
				qcom,mdss-dsi-h-back-porch = <120>;
				qcom,mdss-dsi-h-pulse-width = <2>;
				qcom,mdss-dsi-h-sync-skew = <0>;
				qcom,mdss-dsi-v-back-porch = <8>;
				qcom,mdss-dsi-v-front-porch = <10>;
				qcom,mdss-dsi-v-pulse-width = <3>;
				qcom,mdss-dsi-panel-framerate = <60>;
				qcom,mdss-dsi-on-command = [
					15 01 00 00 00 00 02 FF 23
					15 00 00 00 00 00 02 FB 01
					15 00 00 00 00 00 02 07 20
					15 00 00 00 00 00 02 08 04
					15 01 00 00 00 00 02 ff 25
					15 01 00 00 00 00 02 fb 01
					15 01 00 00 00 00 02 18 96
					15 01 00 00 00 00 02 05 04
					15 01 00 00 00 00 02 ff 20
					15 01 00 00 00 00 02 fb 01
					15 01 00 00 00 00 02 78 01
					15 01 00 00 00 00 02 ff 24
					15 01 00 00 00 00 02 fb 01
					15 01 00 00 00 00 02 82 13
					15 01 00 00 00 00 02 84 31
					15 01 00 00 00 00 02 88 13
					15 01 00 00 00 00 02 8a 31
					15 01 00 00 00 00 02 8e e4
					15 01 00 00 00 00 02 8f 01
					15 01 00 00 00 00 02 90 80
					15 01 00 00 00 00 02 ff 26
					15 01 00 00 00 00 02 fb 01
					15 01 00 00 00 00 02 a9 12
					15 01 00 00 00 00 02 aa 10
					15 01 00 00 00 00 02 ae 8a
					15 01 00 00 00 00 02 ff 10
					05 01 00 00 50 00 02 11 00
					15 01 00 00 00 00 02 b0 01
					15 01 00 00 00 00 02 35 00
					39 01 00 00 00 00 03 68 04 03
					15 01 00 00 00 00 02 51 B8
					15 01 00 00 00 00 02 53 2c
					15 01 00 00 00 00 02 55 00
					05 01 00 00 00 00 02 29 00];
				qcom,mdss-dsi-off-command = [
					05 01 00 00 14 00 02 28 00
					05 01 00 00 64 00 01 10 00];
				qcom,mdss-dsi-on-command-state = "dsi_lp_mode";
				qcom,mdss-dsi-off-command-state = "dsi_hs_mode";
			};
		};
	};
};
